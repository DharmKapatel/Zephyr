## CMakeLists.txt
```
cmake_minimum_required(VERSION 3.20.0)
find_package(Zephyr REQUIRED HINTS $ENV{ZEPHYR_BASE})
project(chatbot)

target_sources(app PRIVATE src/main.c)
```

## prj.conf
```kconfig
CONFIG_CONSOLE=y
CONFIG_UART_CONSOLE=y
CONFIG_SHELL=y
CONFIG_SHELL_BACKENDS=y
CONFIG_SHELL_BACKEND_SERIAL=y
CONFIG_KERNEL_SHELL=y
CONFIG_SHELL_CMDS=y

# Use newlib (full standard C library)
CONFIG_NEWLIB_LIBC=y

# Enable string.h functions
CONFIG_POSIX_API=y

CONFIG_NEWLIB_LIBC=y

# For debugging
CONFIG_PRINTK=y
CONFIG_LOG=y
```

## disco_l475_iot1.overlay
```dts
/ {
	chosen {
		zephyr,console = &usart1;
	};
};
```

## src/main.c
```c
#include <zephyr/kernel.h>
#include <zephyr/shell/shell.h>
#include <zephyr/logging/log.h>
#include <string.h>
#include <stdio.h>
#include <errno.h>

LOG_MODULE_REGISTER(main);

/* Buffer (static array) for question-answer pairs */
static const struct {
	const char *question;
	const char *answer;
} response_buffer[] = {
	{"hello", "hii there"},
	{"bye", "see you later"},
	{"how are you", "I'm fine, thanks!"},
	/* Add more pairs here as needed */
};

/* Shell command handler: chat <message> */
static int cmd_chat(const struct shell *sh, size_t argc, char **argv)
{
	if (argc < 2) {
		shell_error(sh, "Usage: chat <message>");
		return -EINVAL;
	}

	char *message = argv[1];
	bool found = false;
	const char *response = NULL;

	/* Search the buffer for a matching question (case-insensitive) */
	for (size_t i = 0; i < ARRAY_SIZE(response_buffer); i++) {
		if (strcasecmp(message, response_buffer[i].question) == 0) {
			response = response_buffer[i].answer;
			found = true;
			break;
		}
	}

	if (found) {
		shell_print(sh, "%s", response);
	} else {
		shell_print(sh, "Sorry, no response found for '%s'.", message);
	}

	return 0;
}

SHELL_CMD_ARG_REGISTER(chat, NULL, "Chat with the bot: chat <message>", cmd_chat, 2, 0);

void main(void)
{
	LOG_INF("Chatbot ready. Responses stored in buffer. Use 'chat <message>' in shell.");
	/* Shell runs in its own thread; main can sleep */
	while (1) {
		k_sleep(K_MSEC(1000));
	}
}
```
