## task1/build/Kconfig/boards/Kconfig
```kconfig
# Load Zephyr board Kconfig descriptions.
osource "/home/dharm/zephyrproject/zephyr/boards/native/native_sim/Kconfig"
```

## task1/build/Kconfig/boards/Kconfig.defconfig
```kconfig
# Load Zephyr board defconfig descriptions.
osource "/home/dharm/zephyrproject/zephyr/boards/native/native_sim/Kconfig.defconfig"
```

## threads/build/Kconfig/boards/Kconfig.native_sim
```kconfig
# Load board Kconfig descriptions.
osource "/home/dharm/zephyrproject/zephyr/boards/native/native_sim/Kconfig.native_sim"
```

## threads/build/Kconfig/boards/Kconfig.sysbuild
```kconfig
# Load Sysbuild board Kconfig descriptions.
osource "/home/dharm/zephyrproject/zephyr/boards/native/native_sim/Kconfig.sysbuild"
```
