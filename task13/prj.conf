## prj.conf
```kconfig
CONFIG_I2C=y
CONFIG_SENSOR=y
CONFIG_CBPRINTF_FP_SUPPORT=y
CONFIG_LOG=y
CONFIG_SHELL=y

CONFIG_FLASH=y
CONFIG_FLASH_MAP=y
CONFIG_FILE_SYSTEM=y
CONFIG_FILE_SYSTEM_LITTLEFS=y
CONFIG_FILE_SYSTEM_SHELL=y

CONFIG_STDOUT_CONSOLE=y
CONFIG_SENSOR=y

CONFIG_MAIN_STACK_SIZE=2048
CONFIG_SYSTEM_WORKQUEUE_STACK_SIZE=2048
```

## src/main.c
```c
/**
 * @file main.c
 * @brief Entry point for the sensor logging system (Zephyr RTOS).
 *
 * This module initializes the logger and all available sensors:
 * - IMU (Inertial Measurement Unit)
 * - Pressure sensor
 * - Humidity/Temperature sensor
 *
 * Once initialized, the main thread enters an idle loop
 * (`K_FOREVER`) while sensor-specific threads manage data
 * acquisition and enqueue sensor messages to the logger.
 *
 * @author Dharm Kapatel
 * @date 2025
 */

#include <zephyr/kernel.h>
#include <zephyr/logging/log.h>

#include "logger.h"
#include "imu_sensor.h"
#include "pressure_sensor.h"
#include "hum_temp_sensor.h"

LOG_MODULE_REGISTER(main, LOG_LEVEL_INF);

/**
 * @brief Main entry point.
 *
 * Initializes the logging system and all sensor modules.
 * After initialization, the thread sleeps indefinitely,
 * leaving sensor threads to handle acquisition and logging.
 */
int main(void)
{
    LOG_INF("Starting sensor logging system...");

    // Initialize logger first (must be ready before sensor threads start)
    logger_init();

    // Initialize all sensors
    if (imu_sensor_init() < 0) {
        LOG_ERR("Failed to initialize IMU sensor");
    }

    if (pressure_sensor_init() < 0) {
        LOG_ERR("Failed to initialize pressure sensor");
    }

    if (hum_temp_sensor_init() < 0) {
        LOG_ERR("Failed to initialize humidity/temp sensor");
    }

    LOG_INF("All modules initialized, entering idle loop...");

    // Main thread can sleep indefinitely
    while (1) {
        k_sleep(K_FOREVER);  
    }
}
```

## src/hum_tem_sensor.c
```c
/**
 * @file hum_temp_sensor.c
 * @brief Humidity and Temperature sensor interface using Zephyr sensor API.
 *
 * This module handles initialization, periodic sampling, and logging
 * of humidity and temperature data from the HTS221 (or compatible) sensor.
 *
 * The sampled data is packaged into `sensor_data` and pushed to the
 * logger message queue.
 *
 * @author Dharm Kapatel
 */

#include "hum_temp_sensor.h"
#include "logger.h"
#include <zephyr/device.h>
#include <zephyr/drivers/sensor.h>
#include <zephyr/kernel.h>
#include <zephyr/logging/log.h>

LOG_MODULE_REGISTER(hum_temp);

#if DT_NODE_EXISTS(DT_ALIAS(ht_sensor))
/** Sensor device handle retrieved from devicetree alias `ht_sensor`. */
const struct device *const hts_dev = DEVICE_DT_GET(DT_ALIAS(ht_sensor));
#else
#error "Humidity-Temperature sensor not found."
#endif

/**
 * @brief Fetch latest humidity and temperature sensor data.
 *
 * Reads values from the HTS221 sensor and fills the provided
 * `sensor_data` structure with temperature, humidity, and timestamp.
 *
 * @param[out] data Pointer to user-provided struct to hold sensor data.
 *
 * @retval 0 Success
 * @retval -1 Failure (device not ready or sensor read error)
 */
int hum_temp_sensor_get_data(struct sensor_data *data)
{
    if (!device_is_ready(hts_dev)) return -1;
    if (sensor_sample_fetch(hts_dev) < 0) return -1;

    struct sensor_value temp, hum;

    if (sensor_channel_get(hts_dev, SENSOR_CHAN_AMBIENT_TEMP, &temp) < 0)
        return -1;
    if (sensor_channel_get(hts_dev, SENSOR_CHAN_HUMIDITY, &hum) < 0)
        return -1;

    data->sensor_id = SENSOR_TYPE_HUM_TEMP;
    data->hum_temp.temp = sensor_to_float(&temp);
    data->hum_temp.hum  = sensor_to_float(&hum);
    data->timestamp = k_uptime_get();

    return 0;
}

/**
 * @brief Initialize humidity-temperature sensor thread.
 *
 * Ensures the device is ready and starts a dedicated thread
 * for periodic sampling and logging of sensor data.
 *
 * @retval 0 Success
 * @retval -1 Failure (device not ready)
 */
int hum_temp_sensor_init(void)
{
    if (!device_is_ready(hts_dev)) {
        LOG_ERR("HTS221 device not ready");
        return -1;
    }

    static struct k_thread hum_temp_thread_data;
    static K_THREAD_STACK_DEFINE(hum_temp_stack, 1024);

    k_thread_create(&hum_temp_thread_data, hum_temp_stack,
                    K_THREAD_STACK_SIZEOF(hum_temp_stack),
                    hum_temp_thread, NULL, NULL, NULL,
                    5, 0, K_NO_WAIT);

    return 0;
}

/**
 * @brief Thread function for periodic sampling.
 *
 * This thread runs indefinitely, fetching data every 2 seconds
 * from the humidity-temperature sensor and enqueueing it to
 * the logger module.
 *
 * @param a Unused
 * @param b Unused
 * @param c Unused
 */
void hum_temp_thread(void *a, void *b, void *c)
{
    struct sensor_data local;
    struct sensor_message msg;

    while (1) {
        if (hum_temp_sensor_get_data(&local) == 0) {
            msg.data = local;
            logger_enqueue(&msg);
        }
        k_sleep(K_SECONDS(2));
    }
}
```

## src/hum_temp_sensor.h
```c
#ifndef HUM_TEMP_SENSOR_H
#define HUM_TEMP_SENSOR_H

#include "struct.h"

int hum_temp_sensor_init(void);
int hum_temp_sensor_get_data(struct sensor_data *data);
void hum_temp_thread(void *a, void *b, void *c);

#endif /* HUM_TEMP_SENSOR_H */
```

## src/imu_sensor.c
```c
/**
 * @file imu_sensor.c
 * @brief Inertial Measurement Unit (IMU) sensor interface using Zephyr sensor API.
 *
 * This module handles initialization, periodic sampling, and logging
 * of accelerometer and gyroscope data from an IMU sensor (e.g., LSM6DS3).
 *
 * The sampled data is packaged into `sensor_data` and pushed to the
 * logger message queue.
 *
 * @author Dharm Kapatel
 */

#include "imu_sensor.h"
#include "logger.h"
#include "struct.h"
#include <zephyr/device.h>
#include <zephyr/drivers/sensor.h>
#include <zephyr/kernel.h>
#include <zephyr/logging/log.h>

LOG_MODULE_REGISTER(imu);

#if DT_NODE_EXISTS(DT_ALIAS(imu_sensor))
/** Sensor device handle retrieved from devicetree alias `imu_sensor`. */
const struct device *const imu_dev = DEVICE_DT_GET(DT_ALIAS(imu_sensor));
#else
#error "IMU sensor not found."
#endif

/**
 * @brief Fetch latest IMU accelerometer and gyroscope data.
 *
 * Reads accelerometer (X, Y, Z) and gyroscope (X, Y, Z) values from
 * the IMU sensor and fills the provided `imu_data` structure.
 *
 * @param[out] imu Pointer to user-provided struct to hold IMU readings.
 *
 * @retval 0 Success
 * @retval -1 Failure (device not ready or sensor read error)
 */
int imu_sensor_get_data(struct imu_data *imu)
{
    if (!device_is_ready(imu_dev)) {
        return -1;
    }

    if (sensor_sample_fetch(imu_dev) < 0) {
        return -1;
    }

    struct sensor_value accel[3], gyro[3];

    if (sensor_channel_get(imu_dev, SENSOR_CHAN_ACCEL_XYZ, accel) < 0) return -1;
    if (sensor_channel_get(imu_dev, SENSOR_CHAN_GYRO_XYZ, gyro) < 0) return -1;

    imu->ax = sensor_to_float(&accel[0]);
    imu->ay = sensor_to_float(&accel[1]);
    imu->az = sensor_to_float(&accel[2]);

    imu->gx = sensor_to_float(&gyro[0]);
    imu->gy = sensor_to_float(&gyro[1]);
    imu->gz = sensor_to_float(&gyro[2]);

    return 0;
}

/**
 * @brief Initialize IMU sensor thread.
 *
 * Ensures the IMU device is ready and starts a dedicated thread
 * for periodic sampling and logging of accelerometer and gyroscope data.
 *
 * @retval 0 Success
 * @retval -1 Failure (device not ready)
 */
int imu_sensor_init(void)
{
    if (!device_is_ready(imu_dev)) {
        LOG_ERR("IMU sensor not ready");
        return -1;
    }

    static struct k_thread imu_thread_data;
    static K_THREAD_STACK_DEFINE(imu_stack, 1024);

    k_thread_create(&imu_thread_data, imu_stack,
                    K_THREAD_STACK_SIZEOF(imu_stack),
                    imu_thread, NULL, NULL, NULL,
                    5, 0, K_NO_WAIT);

    return 0;
}

/**
 * @brief Thread function for periodic IMU sampling.
 *
 * This thread runs indefinitely, fetching accelerometer and gyroscope
 * data every 4 seconds from the IMU sensor and enqueueing it to
 * the logger module.
 *
 * @param a Unused
 * @param b Unused
 * @param c Unused
 */
void imu_thread(void *a, void *b, void *c)
{
    struct imu_data imu_local;
    struct sensor_message msg;

    while (1) {
        if (imu_sensor_get_data(&imu_local) == 0) {
            msg.data.sensor_id   = SENSOR_TYPE_IMU;
            msg.data.timestamp   = k_uptime_get();
            msg.data.imu         = imu_local;  /**< Store all IMU axis data */

            logger_enqueue(&msg);

            k_sleep(K_SECONDS(4));
        }
    }
}
```

## src/imu_sensor.h
```c
#ifndef IMU_SENSOR_H
#define IMU_SENSOR_H

#include "struct.h"

int imu_sensor_init(void);
int imu_sensor_get_data(struct imu_data *imu);
void imu_thread(void *a, void *b, void *c);

#endif /* IMU_SENSOR_H */
```

## src/logger.c
```c
/**
 * @file logger.c
 * @brief Persistent sensor data logger using LittleFS and circular buffer.
 *
 * This module provides a background thread that consumes sensor messages
 * from a message queue, stores them in a pre-allocated circular buffer file,
 * and maintains persistent metadata for head index and number of entries.
 *
 * The filesystem is mounted on `lfs1_partition` and uses LittleFS.
 *
 * - Data is written to `/lfs/sensor_data`.
 * - Metadata (head index, entry count) is stored in `/lfs/logger_meta`.
 * - Entries are stored in a fixed-size file for efficient overwrites.
 *
 * @note All write operations are thread-safe via a mutex.
 *
 * @author Dharm Kapatel
 */

#include "logger.h"
#include <zephyr/kernel.h>
#include <zephyr/fs/fs.h>
#include <zephyr/fs/littlefs.h>
#include <zephyr/logging/log.h>
#include <string.h> /* memset */

LOG_MODULE_REGISTER(logger);

#define MOUNT_POINT "/lfs"
#define LOG_FILE_PATH "/lfs/sensor_data"

/** Message queue for passing sensor messages to the logger thread. */
K_MSGQ_DEFINE(sensor_msgq, sizeof(struct sensor_message), MAX_QUEUE, 4);

/** Default LittleFS configuration. */
FS_LITTLEFS_DECLARE_DEFAULT_CONFIG(lfs_config);

/** Filesystem mount configuration. */
static struct fs_mount_t mount = {
    .type = FS_LITTLEFS,
    .fs_data = &lfs_config,
    .storage_dev = (void *)FIXED_PARTITION_ID(lfs1_partition),
    .mnt_point = MOUNT_POINT,
};

/** Logger thread handle and stack. */
static struct k_thread logger_thread_data;
static K_THREAD_STACK_DEFINE(logger_stack, 4096);

/** Mutex to guard file access. */
static K_MUTEX_DEFINE(file_mutex);

/** Entry size (one queued record). */
static const size_t ENTRY_SIZE = sizeof(struct sensor_message);

/**
 * @brief Persistent metadata for circular buffer.
 *
 * This metadata is stored in `/lfs/logger_meta` and tracks:
 * - `head_index`: next write index in circular buffer.
 * - `entries_count`: number of valid entries currently stored.
 */
struct logger_meta {
    uint32_t head_index;     /**< Next write index (0..MAX_ENTRIES-1). */
    uint32_t entries_count;  /**< Number of valid entries (<= MAX_ENTRIES). */
} __packed;

/** Runtime metadata copy. */
static struct logger_meta meta;

/** Path to metadata file. */
#define META_FILE_PATH MOUNT_POINT "/logger_meta"

/**
 * @brief Save metadata persistently to LittleFS.
 *
 * @param[in] m Pointer to metadata structure to save.
 *
 * @retval 0 Success
 * @retval -1 Failure
 */
static int meta_save(const struct logger_meta *m)
{
    struct fs_file_t f;
    fs_file_t_init(&f);
    if (fs_open(&f, META_FILE_PATH, FS_O_CREATE | FS_O_TRUNC | FS_O_WRITE) != 0) {
        return -1;
    }
    ssize_t written = fs_write(&f, (const void *)m, sizeof(*m));
    fs_close(&f);
    return (written == (ssize_t)sizeof(*m)) ? 0 : -1;
}

/**
 * @brief Load metadata from LittleFS.
 *
 * @param[out] m Pointer to structure to fill with loaded metadata.
 *
 * @retval 0 Success
 * @retval -1 Failure
 */
static int meta_load(struct logger_meta *m)
{
    struct fs_file_t f;
    fs_file_t_init(&f);
    if (fs_open(&f, META_FILE_PATH, FS_O_READ) != 0) {
        return -1;
    }
    ssize_t r = fs_read(&f, (void *)m, sizeof(*m));
    fs_close(&f);
    return (r == (ssize_t)sizeof(*m)) ? 0 : -1;
}

/**
 * @brief Ensure the data file exists and is pre-allocated.
 *
 * Creates `/lfs/sensor_data` if missing, and pre-allocates space for
 * `MAX_ENTRIES * ENTRY_SIZE` bytes to support circular buffer writes.
 */
static void ensure_data_file(void)
{
    struct fs_file_t f;
    fs_file_t_init(&f);

    const size_t total_bytes = (size_t)MAX_ENTRIES * ENTRY_SIZE;

    /* If file exists and is already large enough, nothing to do */
    struct fs_dirent entry;
    if (fs_stat(LOG_FILE_PATH, &entry) == 0) {
        if ((size_t)entry.size >= total_bytes) {
            LOG_INF("%s exists and size OK (%u entries)", LOG_FILE_PATH, MAX_ENTRIES);
            return;
        }
    }

    /* Open file (create if missing) for read/write so we can probe/extend */
    if (fs_open(&f, LOG_FILE_PATH, FS_O_CREATE | FS_O_RDWR) != 0) {
        LOG_ERR("Failed to open/create %s", LOG_FILE_PATH);
        return;
    }

    /* Find current size by seeking to end then telling */
    off_t cur_size = 0;
    if (fs_seek(&f, 0, FS_SEEK_END) == 0) {
        cur_size = fs_tell(&f);
        if (cur_size < 0) {
            LOG_WRN("fs_tell returned < 0 (%ld), treating as 0", (long)cur_size);
            cur_size = 0;
        }
    } else {
        LOG_WRN("fs_seek to end failed, treating current size as 0");
    }

    /* If file is smaller than required, try a cheap probe first */
    if ((size_t)cur_size < total_bytes) {
        off_t probe_offset = (off_t)(total_bytes - 1);
        bool probe_ok = false;

        if (fs_seek(&f, probe_offset, FS_SEEK_SET) == 0) {
            uint8_t probe = 0;
            ssize_t w = fs_write(&f, &probe, 1);
            if (w == 1) {
                probe_ok = true;
                LOG_INF("Probe write succeeded — no bulk pre-allocation required");
            } else {
                LOG_WRN("Probe write failed (w=%zd), will fall back to safe extend", w);
            }
        } else {
            LOG_WRN("Probe seek to %ld failed, will fall back to safe extend", (long)probe_offset);
        }

        
    } else {
        LOG_INF("%s already large enough (%zu bytes)", LOG_FILE_PATH, (size_t)cur_size);
    }

    fs_close(&f);
}

/**
 * @brief Logger background thread.
 *
 * This thread waits for messages in the queue, writes them into the
 * circular buffer at the current head index, and updates metadata.
 *
 * @param a Unused
 * @param b Unused
 * @param c Unused
 */
static void logger_thread(void *a, void *b, void *c)
{
    struct sensor_message msg;
    struct fs_file_t file;
    fs_file_t_init(&file);

    while (1) {
        if (k_msgq_get(&sensor_msgq, &msg, K_FOREVER) == 0) {
            k_mutex_lock(&file_mutex, K_FOREVER);

            /* Open for read/write (we'll seek & overwrite at a specific offset) */
            if (fs_open(&file, LOG_FILE_PATH, FS_O_RDWR) == 0) {
                off_t offset = (off_t)meta.head_index * ENTRY_SIZE;
                fs_seek(&file, offset, FS_SEEK_SET);
                ssize_t w = fs_write(&file, &msg, ENTRY_SIZE);
                fs_close(&file);

                if (w == (ssize_t)ENTRY_SIZE) {
                    /* advance head & update entries_count */
                    meta.head_index = (meta.head_index + 1) % MAX_ENTRIES;
                    if (meta.entries_count < MAX_ENTRIES) {
                        meta.entries_count++;
                    }
                    if (meta_save(&meta) != 0) {
                        LOG_ERR("Failed to persist meta");
                    }
                } else {
                    LOG_ERR("Failed to write full entry (w=%zd)", w);
                }
            } else {
                LOG_ERR("Failed to open data file for writing");
            }

            k_mutex_unlock(&file_mutex);
        }
    }
}

/**
 * @brief Initialize logger system.
 *
 * - Mounts the filesystem.
 * - Ensures the data file exists (creates if missing).
 * - Loads metadata (creates new if missing).
 * - Starts the logger thread.
 */
void logger_init(void)
{
    int rc = fs_mount(&mount);
    if (rc == 0) {
        LOG_INF("Filesystem mounted at %s", mount.mnt_point);
    } else {
        LOG_ERR("Failed to mount FS (%d)", rc);
        return;
    }

    /* Ensure data file exists (creates & preallocates if necessary) */
    ensure_data_file();

    /* Try to load persisted meta; if not present, initialize it and persist */
    if (meta_load(&meta) != 0) {
        LOG_INF("No logger meta found: initializing meta");
        meta.head_index = 0;
        meta.entries_count = 0;
        if (meta_save(&meta) != 0) {
            LOG_ERR("Failed to create meta file");
        } else {
            LOG_INF("Created meta file %s", META_FILE_PATH);
        }
    } else {
        LOG_INF("Loaded logger meta: head=%u entries=%u",
                meta.head_index, meta.entries_count);
    }

    /* start the logger thread */
    k_thread_create(&logger_thread_data, logger_stack,
                    K_THREAD_STACK_SIZEOF(logger_stack),
                    logger_thread, NULL, NULL, NULL,
                    5, 0, K_NO_WAIT);
}

/**
 * @brief Enqueue a sensor message to be logged.
 *
 * Non-blocking enqueue: if queue is full, the message is dropped.
 *
 * @param[in] msg Pointer to message to enqueue.
 */
void logger_enqueue(const struct sensor_message *msg)
{
    k_msgq_put(&sensor_msgq, msg, K_NO_WAIT);
}
```

## src/logger.h
```c
/**
 * @file logger.h
 * @author Dharm
 * @brief Logging interface for queuing sensor messages in Zephyr.
 *
 * This module provides functions to enqueue sensor messages into
 * a message queue for further processing (e.g., storage, transmission).
 * It also defines helper functions for sensor value conversions.
 */

#ifndef LOGGER_H
#define LOGGER_H

#include <zephyr/kernel.h>
#include <zephyr/drivers/sensor.h>
#include "struct.h"

/**
 * @brief Convert Zephyr sensor_value struct to float.
 *
 * Converts a Zephyr @ref sensor_value (integer + fractional part)
 * into a single-precision float for easier handling.
 *
 * @param val Pointer to sensor_value structure.
 * @return Floating-point representation of the sensor value.
 */
static inline float sensor_to_float(const struct sensor_value *val)
{
    return (float)val->val1 + (float)val->val2 / 1000000.0f;
}

/** @brief Maximum number of queued messages in memory. */
#define MAX_QUEUE 50

/** @brief Maximum number of entries stored in logger. */
#define MAX_ENTRIES 1000

/**
 * @brief Initialize the logger module.
 *
 * This function sets up internal data structures such as
 * queues and storage for incoming sensor messages.
 */
void logger_init(void);

/**
 * @brief Enqueue a sensor message into the logger queue.
 *
 * @param msg Pointer to a sensor_message structure containing sensor data.
 */
void logger_enqueue(const struct sensor_message *msg);

#endif /* LOGGER_H */
```

## src/pressure_sensor.c
```c
#include "pressure_sensor.h"
#include "logger.h"
#include <zephyr/device.h>
#include <zephyr/drivers/sensor.h>
#include <zephyr/kernel.h>
#include <zephyr/logging/log.h>

LOG_MODULE_REGISTER(pressure);

#if DT_NODE_EXISTS(DT_ALIAS(pressure_sensor))
const struct device *const pressure_dev = DEVICE_DT_GET(DT_ALIAS(pressure_sensor));
#else
#error "Pressure sensor not found."
#endif

int pressure_sensor_get_data(struct sensor_data *data)
{
    if (!device_is_ready(pressure_dev)) return -1;
    if (sensor_sample_fetch(pressure_dev) < 0) return -1;

    struct sensor_value press;
    if (sensor_channel_get(pressure_dev, SENSOR_CHAN_PRESS, &press) < 0)
        return -1;

    data->sensor_id = SENSOR_TYPE_PRESSURE;
    data->pressure.pressure = sensor_to_float(&press);
    data->timestamp = k_uptime_get();

    return 0;
}

int pressure_sensor_init(void)
{
    if (!device_is_ready(pressure_dev)) {
        LOG_ERR("Pressure sensor not ready");
        return -1;
    }

    static struct k_thread pressure_thread_data;
    static K_THREAD_STACK_DEFINE(pressure_stack, 1024);
    k_thread_create(&pressure_thread_data, pressure_stack,
                    K_THREAD_STACK_SIZEOF(pressure_stack),
                    pressure_thread, NULL, NULL, NULL,
                    5, 0, K_NO_WAIT);

    return 0;
}

void pressure_thread(void *a, void *b, void *c)
{
    struct sensor_data local;
    struct sensor_message msg;

    while (1) {
        if (pressure_sensor_get_data(&local) == 0) {
            msg.data = local;
            logger_enqueue(&msg);
        }
        k_sleep(K_SECONDS(3));
    }
}
```

## src/pressure_sensor.h
```c
/**
 * @file pressure_sensor.h
 * @brief Pressure sensor module interface.
 *
 * This header provides function prototypes for initializing,
 * sampling, and running the pressure sensor background thread.
 *
 * Author: Dharm Kapatel
 */

#ifndef PRESSURE_SENSOR_H
#define PRESSURE_SENSOR_H

#include "struct.h"



/**
 * @brief Initialize the pressure sensor module.
 *
 * Checks device readiness and starts the background thread for
 * periodic pressure sampling.
 *
 * @retval 0  Success
 * @retval -1 Device not ready
 */
int pressure_sensor_init(void);

/**
 * @brief Get the latest pressure data sample.
 *
 * Fetches a single reading from the sensor and fills the given
 * @ref sensor_data structure with the result.
 *
 * @param[out] data Pointer to structure where data is stored.
 *
 * @retval 0  Success
 * @retval -1 Failure (device not ready or fetch error)
 */
int pressure_sensor_get_data(struct sensor_data *data);

/**
 * @brief Pressure sensor background thread.
 *
 * This thread continuously fetches pressure samples at a fixed
 * interval and enqueues them into the logger system.
 *
 * @param a Unused
 * @param b Unused
 * @param c Unused
 */
void pressure_thread(void *a, void *b, void *c);



#endif /* PRESSURE_SENSOR_H */
```

## src/struct.h
```c
#ifndef STRUCTS_H
#define STRUCTS_H

#include <stdint.h>

/* Sensor type IDs */
typedef enum {
    SENSOR_TYPE_HUM_TEMP = 0,
    SENSOR_TYPE_PRESSURE = 1,
    SENSOR_TYPE_IMU      = 2,
} sensor_type_t;

/* Data structs for each sensor */
struct hum_temp_data {
    float temp;
    float hum;
};

struct pressure_data {
    float pressure;
};

struct imu_data {
    float ax, ay, az;
    float gx, gy, gz;
};

/* Unified sensor data struct for logging */
struct sensor_data {
    int sensor_id;       // sensor type
    int64_t timestamp;   // milliseconds since boot
    union {
        struct hum_temp_data hum_temp;
        struct pressure_data pressure;
        struct imu_data imu;
        float value;  // fallback single value
    };
};

/* Generic sensor message to pass through the queue */
struct sensor_message {
    struct sensor_data data;
};

#endif /* STRUCTS_H */
```
